## sdkconfig.defaults
```kconfig
# Rust often needs a bit of an extra main task stack size compared to C (the default is 3K)
CONFIG_ESP_MAIN_TASK_STACK_SIZE=8000

# Use this to set FreeRTOS kernel tick frequency to 1000 Hz (100 Hz by default).
# This allows to use 1 ms granularity for thread sleeps (10 ms by default).
#CONFIG_FREERTOS_HZ=1000

# Workaround for https://github.com/espressif/esp-idf/issues/7631
#CONFIG_MBEDTLS_CERTIFICATE_BUNDLE=n
#CONFIG_MBEDTLS_CERTIFICATE_BUNDLE_DEFAULT_FULL=n
CONFIG_BT_ENABLED=y
CONFIG_BT_BLE_ENABLED=y
CONFIG_BT_BLUEDROID_ENABLED=n
CONFIG_BT_NIMBLE_ENABLED=y

# Enable FATFS
CONFIG_FATFS_ENABLE=y
CONFIG_FATFS_CODEPAGE=437
CONFIG_FATFS_LFN_HEAP=y
CONFIG_FATFS_MAX_LFN=255
CONFIG_FATFS_API_ENCODING_ANSI=y

# Use wear-leveling layer on spiflash (recommended)
CONFIG_WL_SECTOR_SIZE_4096=y

# Optional: mount at boot? we will mount in code, so can leave off
# CONFIG_FATFS_MOUNT_AT_BOOT=y

# If you want auto-format on mount failure (can also set mount config)
CONFIG_FATFS_FORMAT_IF_MOUNT_FAILED=y
```
